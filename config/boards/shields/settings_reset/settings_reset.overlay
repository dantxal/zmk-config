/*
 * Copyright (c) 2020 The ZMK Contributors
 *
 * SPDX-License-Identifier: MIT
 */

#include <dt-bindings/zmk/matrix_transform.h>

/ {
  chosen {
    zmk,kscan = &kscan0;
    zmk,matrix_transform = &default_transform;
  };

  default_transform: keymap_transform_0 {
    compatible = "zmk,matrix-transform";
    columns = <1>;
    rows = <1>;
    map = <RC(0,0)>;
  };

  kscan0: kscan {
    compatible = "zmk,kscan-gpio-matrix";
    label = "KSCAN";
    diode-direction = "row2col";

    row-gpios = <&gpio0  2 (GPIO_ACTIVE_HIGH | GPIO_PULL_DOWN)>;
    col-gpios = <&gpio1 15 (GPIO_ACTIVE_HIGH | GPIO_PULL_DOWN)>;
  };
};

