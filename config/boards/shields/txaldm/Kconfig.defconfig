## config/boards/shields/txaldm/Kconfig.defconfig
```kconfig
# Copyright (c) 2020 The ZMK Contributors
# SPDX-License-Identifier: MIT

config ZMK_KEYBOARD_NAME
	default "Txal Dactyl"

if SHIELD_TXALDM_LEFT

config ZMK_SPLIT_ROLE_CENTRAL
	default y

endif

if SHIELD_TXALDM_LEFT || SHIELD_TXALDM_RIGHT

config ZMK_SPLIT
	default y

endif
```

## config/boards/shields/txaldm_reset/Kconfig.defconfig
```kconfig
# Copyright (c) 2020 The ZMK Contributors
# SPDX-License-Identifier: MIT

if SHIELD_TXALDM_RESET

config ZMK_KEYBOARD_NAME
	default "Txal Reset"

endif
```

## config/boards/shields/txaldm_reset/Kconfig.shield
```kconfig
# Copyright (c) 2020 The ZMK Contributors
# SPDX-License-Identifier: MIT

config SHIELD_TXALDM_RESET
    def_bool $(shields_list_contains,txaldm_reset)
```
